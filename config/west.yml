## config/west.yml
```yaml
manifest:
  remotes:
    - name: zmkfirmware
      url-base: https://github.com/zmkfirmware
    - name: splittedspace
      url-base: https://github.com/SplittedSpace
    - name: urob
      url-base: https://github.com/urob

  projects:
    - name: zmk
      remote: zmkfirmware
      revision: v0.3-branch
      import: app/west.yml
    - name: zmk-feature-splittedspace
      remote: splittedspace
      revision: main
    - name: zmk-keyboards-splittedspace
      remote: splittedspace
      revision: main
    - name: zmk-tri-state
      remote: urob
      revision: main

  self:
    path: config
```
